/**
 * Copyright (c) 2023 Nordic Semiconductor ASA
 *
 * SPDX-License-Identifier: LicenseRef-Nordic-5-Clause
 */

.param_1 = {0.0, 0.005, 0.01, 0.015, 0.02, 0.025, 0.03, 0.035, 0.04, 0.045, 0.05, 0.055, 0.06, 0.065, 0.07, 0.075, 0.08, 0.085, 0.09, 0.095, 0.1, 0.105, 0.11, 0.115, 0.12, 0.125, 0.13, 0.135, 0.14, 0.145, 0.15, 0.155, 0.16, 0.165, 0.17, 0.17500000000000002, 0.18, 0.185, 0.19, 0.195, 0.2, 0.20500000000000002, 0.21, 0.215, 0.22, 0.225, 0.23, 0.23500000000000001, 0.24, 0.245, 0.25, 0.255, 0.26, 0.265, 0.27, 0.275, 0.28, 0.28500000000000003, 0.29, 0.295, 0.3, 0.305, 0.31, 0.315, 0.32, 0.325, 0.33, 0.335, 0.34, 0.34500000000000003, 0.35000000000000003, 0.355, 0.36, 0.365, 0.37, 0.375, 0.38, 0.385, 0.39, 0.395, 0.4, 0.405, 0.41000000000000003, 0.41500000000000004, 0.42, 0.425, 0.43, 0.435, 0.44, 0.445, 0.45, 0.455, 0.46, 0.465, 0.47000000000000003, 0.47500000000000003, 0.48, 0.485, 0.49, 0.495, 0.5, 0.505, 0.51, 0.515, 0.52, 0.525, 0.53, 0.535, 0.54, 0.545, 0.55, 0.555, 0.56, 0.5650000000000001, 0.5700000000000001, 0.5750000000000001, 0.58, 0.585, 0.59, 0.595, 0.6, 0.605, 0.61, 0.615, 0.62, 0.625, 0.63, 0.635, 0.64, 0.645, 0.65, 0.655, 0.66, 0.665, 0.67, 0.675, 0.68, 0.685, 0.6900000000000001, 0.6950000000000001, 0.7000000000000001, 0.705, 0.71, 0.715, 0.72, 0.725, 0.73, 0.735, 0.74, 0.745, 0.75, 0.755, 0.76, 0.765, 0.77, 0.775, 0.78, 0.785, 0.79, 0.795, 0.8, 0.805, 0.81, 0.8150000000000001, 0.8200000000000001, 0.8250000000000001, 0.8300000000000001, 0.835, 0.84, 0.845, 0.85, 0.855, 0.86, 0.865, 0.87, 0.875, 0.88, 0.885, 0.89, 0.895, 0.9, 0.905, 0.91, 0.915, 0.92, 0.925, 0.93, 0.935, 0.9400000000000001, 0.9450000000000001, 0.9500000000000001, 0.9550000000000001, 0.96, 0.965, 0.97, 0.975, 0.98, 0.985, 0.99, 0.995, 1.0},
.temps = {25.0},
.param_2 = {2.99, 3.0, 3.0100000000000002, 3.02, 3.0300000000000002, 3.04, 3.0500000000000003, 3.06, 3.0700000000000003, 3.08, 3.0900000000000003, 3.1, 3.1100000000000003, 3.12, 3.1300000000000003, 3.14, 3.1500000000000004, 3.16, 3.1700000000000004, 3.18, 3.1900000000000004, 3.2, 3.2100000000000004, 3.22, 3.2300000000000004, 3.24, 3.25, 3.2600000000000002, 3.2700000000000005, 3.2800000000000002, 3.29, 3.3000000000000003, 3.31, 3.3200000000000003, 3.33, 3.3400000000000003, 3.35, 3.3600000000000003, 3.37, 3.3800000000000003, 3.39, 3.4000000000000004, 3.41, 3.4200000000000004, 3.43, 3.4400000000000004, 3.45, 3.4600000000000004, 3.47, 3.4800000000000004, 3.49, 3.5, 3.5100000000000002, 3.5200000000000005, 3.5300000000000002, 3.54, 3.5500000000000003, 3.5600000000000005, 3.5700000000000003, 3.58, 3.5900000000000003, 3.6, 3.6100000000000003, 3.62, 3.6300000000000003, 3.64, 3.6500000000000004, 3.66, 3.6700000000000004, 3.68, 3.6900000000000004, 3.7, 3.71, 3.72, 3.7300000000000004, 3.74, 3.75, 3.7600000000000002, 3.7700000000000005, 3.7800000000000002, 3.79, 3.8000000000000003, 3.8100000000000005, 3.8200000000000003, 3.83, 3.8400000000000003, 3.85, 3.8600000000000003, 3.87, 3.8800000000000003, 3.89, 3.9000000000000004, 3.91, 3.9200000000000004, 3.93, 3.9400000000000004, 3.95, 3.96, 3.97, 3.9800000000000004, 3.99, 4.0, 4.01, 4.0200000000000005, 4.03, 4.04, 4.050000000000001, 4.0600000000000005, 4.07, 4.08, 4.09, 4.1000000000000005, 4.11, 4.12, 4.130000000000001, 4.140000000000001, 4.15, 4.16, 4.17, 4.18, 4.19, 4.2},
.param_3 = {0.11121900868513712, 0.12422101067149485, 0.12607219830873084, 0.12774786488014228, 0.12920468216882502, 0.13045808717206772, 0.13160814130854911, 0.13253134537889863, 0.1334680228217855, 0.13425135612140454, 0.13500789808503635, 0.13570550160942105, 0.1361568733613031, 0.13662640021386643, 0.13683279812262678, 0.1371242830795297, 0.13726624910979277, 0.13738344314888848, 0.13750995230484425, 0.13766644240274528, 0.13772854722631506, 0.1377887285529451, 0.13795646241739407, 0.1380107820501414, 0.13807488014186128, 0.13825332614124236, 0.13836656215126447, 0.1384079948276928, 0.1385295263649907, 0.13869895663932633, 0.1388650407916442, 0.139028393367389, 0.13919454579321797, 0.13936486413970023, 0.1395450679793907, 0.13965227795879065, 0.13983939593158823, 0.14002413470927996, 0.1401272903402806, 0.1403099324774379, 0.1404121180382057, 0.14058845121545585, 0.1406753372820967, 0.14084022906667912, 0.1409585862729471, 0.1411335585478454, 0.1411831186778521, 0.14130021745745627, 0.1414955562337347, 0.14153607631231152, 0.14165301843047454, 0.14171540782151984, 0.1418615638607605, 0.14193956361378632, 0.1420533795376911, 0.14216887133573286, 0.14228267261947045, 0.14236412633066886, 0.1424542349361987, 0.1425685152527214, 0.14268408496108728, 0.14280474893593817, 0.14289816704421116, 0.14296057552213984, 0.1430851413717615, 0.14319680343533514, 0.1432521976459892, 0.14336640637474055, 0.14343937763077116, 0.14348250986123365, 0.14358685050444617, 0.1436693312384433, 0.14375372404353454, 0.1438388636746227, 0.14384746875601787, 0.1439657872101195, 0.14396199776476462, 0.14401505611902574, 0.14407560012480358, 0.14413395324812509, 0.14418449007911796, 0.1442766487023331, 0.14438186755433835, 0.14440983935772062, 0.1444161599120859, 0.14447986204003418, 0.1445370349113808, 0.14459319471740378, 0.1446591607778071, 0.1446561994670941, 0.1447385865975287, 0.1448339675691708, 0.14487935891842732, 0.14494609197519517, 0.14498639686522743, 0.14498871572236802, 0.14505035973558922, 0.1451076068779128, 0.1451690825513103, 0.14520742647078855, 0.14538148422615452, 0.14540299262817716, 0.14540043109912199, 0.1455555854560257, 0.1456298005182993, 0.14562598875165894, 0.14569492094465566, 0.14581164290264415, 0.14587354732712837, 0.14592193081147117, 0.14603133431707724, 0.14611540908063828, 0.14615708220763485, 0.14624850881569862, 0.14634878444006297, 0.14640889184640288, 0.14653273823782723, 0.14664621692473948, 0.14670243712511488, 0.14680905416464787, 0.14693792370907416, 0.14699593617175327, 0.147122933491371, 0.1472831422515077, 0.1473889766644854, 0.14750382204926105, 0.1476263565358421, 0.14780359841184632, 0.14797661292637096, 0.14814913768055815, 0.14832445427306418, 0.1484892511279998, 0.14870451004547774, 0.14891432441135752, 0.14907195194443726, 0.14926850418899568, 0.14949203967015837, 0.14966514786581095, 0.14989855056531065, 0.15007449737882364, 0.150245464382044, 0.1504196960091958, 0.1505922647623719, 0.15076581149885612, 0.15093844782172472, 0.15111372383327198, 0.15128210810030165, 0.151464972997341, 0.1516955184303614, 0.15181094582798657, 0.15196992590427272, 0.15220085456312502, 0.15239330065398493, 0.15256001539547906, 0.1527351764188436, 0.15290787077029913, 0.15308111001671787, 0.15325439239719452, 0.15342780386055094, 0.15360105744587668, 0.1537690725629915, 0.1539977675572263, 0.15418822675835567, 0.15435781451297703, 0.15452334129612727, 0.15473063864284425, 0.1549331823483011, 0.15504147725122874, 0.15522810970869874, 0.1554599510757913, 0.1556347916628122, 0.15580747917840584, 0.1559736600293039, 0.15619220693803615, 0.1563968552404601, 0.15656126947250218, 0.15673821220407558, 0.15690646007515513, 0.15708897928009372, 0.1573206985220497, 0.1574902705755722, 0.1577285662709955, 0.1578457530106613, 0.15809099582112648, 0.15832512861796766, 0.15849838659266346, 0.15874227048496173, 0.15896898716170443, 0.1591371939787178, 0.15930972329012053, 0.15953472061606797, 0.1597745298503543, 0.15998364395622436, 0.1601798516521619, 0.1604018899725125, 0.16063989652450558, 0.16085097893487046, 0.16102369615090428, 0.16118574644120282, 0.16136719599366658, 0.1615981109961957},
.param_4 = {0.004448760347405486, 0.004968840426859795, 0.0050428879323492345, 0.005109914595205692, 0.005168187286753002, 0.00521832348688271, 0.005264325652341965, 0.005301253815155946, 0.00533872091287142, 0.005370054244856182, 0.005400315923401455, 0.0054282200643768425, 0.005446274934452125, 0.005465056008554659, 0.0054733119249050725, 0.005484971323181189, 0.005490649964391711, 0.00549533772595554, 0.005500398092193771, 0.005506657696109812, 0.005509141889052604, 0.005511549142117805, 0.005518258496695763, 0.005520431282005657, 0.005522995205674452, 0.005530133045649696, 0.00553466248605058, 0.005536319793107714, 0.005541181054599628, 0.005547958265573054, 0.0055546016316657685, 0.005561135734695561, 0.005567781831728719, 0.00557459456558801, 0.005581802719175629, 0.005586091118351627, 0.005593575837263531, 0.005600965388371199, 0.005605091613611225, 0.005612397299097517, 0.005616484721528228, 0.005623538048618235, 0.005627013491283869, 0.005633609162667166, 0.005638343450917885, 0.005645342341913818, 0.0056473247471140854, 0.005652008698298253, 0.0056598222493493885, 0.005661443052492462, 0.005666120737218983, 0.005668616312860794, 0.005674462554430421, 0.005677582544551454, 0.0056821351815076445, 0.0056867548534293155, 0.005691306904778819, 0.005694565053226756, 0.005698169397447949, 0.005702740610108858, 0.005707363398443493, 0.005712189957437527, 0.005715926681768447, 0.005718423020885595, 0.005723405654870462, 0.005727872137413407, 0.005730087905839569, 0.005734656254989623, 0.0057375751052308474, 0.005739300394449347, 0.005743474020177848, 0.0057467732495377335, 0.005750148961741382, 0.00575355454698491, 0.005753898750240716, 0.00575863148840478, 0.005758479910590586, 0.00576060224476103, 0.005763024004992144, 0.005765358129925005, 0.005767379603164719, 0.005771065948093324, 0.005775274702173535, 0.005776393574308826, 0.005776646396483437, 0.005779194481601369, 0.005781481396455234, 0.0057837277886961524, 0.005786366431112285, 0.005786247978683765, 0.005789543463901149, 0.005793358702766834, 0.005795174356737094, 0.005797843679007808, 0.005799455874609099, 0.005799548628894721, 0.00580201438942357, 0.005804304275116513, 0.005806763302052414, 0.005808297058831543, 0.005815259369046181, 0.005816119705127088, 0.00581601724396488, 0.00582222341824103, 0.005825192020731973, 0.005825039550066359, 0.005827796837786227, 0.005832465716105767, 0.005834941893085137, 0.005836877232458848, 0.005841253372683091, 0.005844616363225532, 0.005846283288305396, 0.005849940352627946, 0.00585395137760252, 0.0058563556738561165, 0.00586130952951309, 0.00586584867698958, 0.0058680974850045965, 0.005872362166585916, 0.005877516948362967, 0.005879837446870132, 0.005884917339654842, 0.0058913256900603094, 0.005895559066579417, 0.005900152881970443, 0.005905054261433685, 0.005912143936473853, 0.00591906451705484, 0.0059259655072223276, 0.005932978170922568, 0.005939570045119993, 0.005948180401819111, 0.005956572976454301, 0.0059628780777774915, 0.0059707401675598275, 0.005979681586806336, 0.005986605914632439, 0.005995942022612427, 0.006002979895152947, 0.006009818575281762, 0.0060167878403678335, 0.006023690590494877, 0.006030632459954246, 0.00603753791286899, 0.006044548953330881, 0.006051284324012068, 0.006058598919893641, 0.006067820737214457, 0.006072437833119464, 0.0060787970361709095, 0.006088034182525002, 0.006095732026159398, 0.006102400615819164, 0.006109407056753745, 0.006116314830811966, 0.006123244400668716, 0.006130175695887782, 0.006137112154422039, 0.006144042297835068, 0.006150762902519661, 0.006159910702289053, 0.006167529070334229, 0.006174312580519082, 0.006180933651845091, 0.0061892255457137715, 0.006197327293932045, 0.006201659090049151, 0.006209124388347951, 0.006218398043031654, 0.006225391666512489, 0.006232299167136236, 0.0062389464011721575, 0.006247688277521447, 0.006255874209618405, 0.006262450778900089, 0.006269528488163024, 0.006276258403006206, 0.00628355917120375, 0.0062928279408819895, 0.006299610823022888, 0.006309142650839821, 0.006313830120426454, 0.006323639832845061, 0.0063330051447187076, 0.00633993546370654, 0.00634969081939847, 0.0063587594864681785, 0.006365487759148714, 0.0063723889316048225, 0.00638138882464272, 0.006390981194014173, 0.006399345758248976, 0.006407194066086477, 0.006416075598900502, 0.006425595860980225, 0.006434039157394819, 0.006440947846036172, 0.006447429857648114, 0.006454687839746664, 0.006463924439847829},
.param_5 = {0.10401601589086189, 0.059412758494374864, 0.014107416834589683, 0.012529935440376734, 0.010840889167701775, 0.009613836558896357, 0.0082930328273236, 0.007439526052945445, 0.006880042970023627, 0.00615950105300354, 0.005816581952066031, 0.004595901105066986, 0.003683594417781648, 0.0027036990452947336, 0.0019915314626530248, 0.001733803948663834, 0.0010366402774350698, 0.0009748127802060129, 0.0011319970154272108, 0.0008743796858832684, 0.0004891446007992614, 0.0009116607643159733, 0.0008882139887852157, 0.0004736708978688234, 0.0009701763644039477, 0.0011667280376128492, 0.0006186747458017394, 0.0006518568549047747, 0.0011638472465340735, 0.001342057706614063, 0.0013177469122506967, 0.001318020006295037, 0.001345883089244864, 0.0014020887446910234, 0.0011496552763616726, 0.0011773118087901949, 0.0014874270019572464, 0.0011515776347693733, 0.0011431910726317392, 0.0011393107917003625, 0.0011140749520718689, 0.0010528769755640405, 0.0010071114048930407, 0.0011329959634016375, 0.0011733179246652126, 0.0008981296196200299, 0.0006666356384434774, 0.0012497502235303028, 0.0009434354194209557, 0.0006298487869594617, 0.0007173260368332005, 0.000834181721143766, 0.0008966231690659722, 0.0007672627077223715, 0.0009172308877861655, 0.0009171723271174381, 0.0007810199797440333, 0.0006862492669130159, 0.0008175556882102086, 0.0009194000995543621, 0.0009449347328669214, 0.000856328332495427, 0.0006233063448067566, 0.0007478973102014765, 0.0009449116527812489, 0.0006682250969107517, 0.0006784117576215387, 0.000748719939127826, 0.00046441394597239796, 0.0005898914947000816, 0.0007472855088386937, 0.0006674941563533654, 0.0006781297447176239, 0.00037497884993343417, 0.000507694141987057, 0.00045811603498696965, 0.00019707563562497768, 0.0004544094401558174, 0.000475588516397462, 0.0004355598172574998, 0.0005707818168319313, 0.0007895099008815853, 0.0005327626215501612, 0.00013716943099021175, 0.000280090729254303, 0.00048349999717967745, 0.00045333070947837714, 0.0004885034657051146, 0.0002520189987612227, 0.0003177032788863679, 0.0007110724083068953, 0.0005630892835945325, 0.0004484976240974256, 0.00042815178720049044, 0.00017049498869129917, 0.0002558514814471162, 0.000475564622179174, 0.0004748912628843756, 0.00039927837150307774, 0.0008496066993767502, 0.0007822646295544203, 7.578749186987893e-05, 0.0006103713113942387, 0.0009174776767093169, 0.00028161318253294015, 0.0002604817054253916, 0.0007426166039407531, 0.0007145055298909617, 0.0004411516353081124, 0.0006311479597954396, 0.0007739130766683602, 0.0005029915622304683, 0.0005323989402413951, 0.000766808929712412, 0.0006415321228170866, 0.0007358151910569904, 0.0009493003133463282, 0.0006787955491506514, 0.0006513489596336221, 0.0009419463358370864, 0.0007475280284215818, 0.0007400391291875058, 0.0011488243190177667, 0.0010641726924574824, 0.0008827191910133932, 0.0009495194854268127, 0.0011991054503409856, 0.0014010255621154516, 0.0013821570748474322, 0.0013913653867728137, 0.0013604537897665171, 0.0015202230896542955, 0.0017002931334308621, 0.0014697675958380563, 0.0014167191105526195, 0.001680350902884438, 0.0015865747072611562, 0.0016260435806091447, 0.0016373980520507751, 0.0013876552669334248, 0.0013807945214886624, 0.0013872015213115332, 0.0013844619586412393, 0.0013847322374113506, 0.0013916493376634788, 0.0013746411143077293, 0.0014049966562760738, 0.0016536413202389126, 0.0013838913225822612, 0.001097629895645269, 0.0015596349405538022, 0.0016934989988488455, 0.0014366433294161866, 0.001367503059434682, 0.0013914214992802494, 0.0013837343914971205, 0.0013860865075815756, 0.001386775375332265, 0.0013866601947285818, 0.0013650748097622512, 0.0015868404453984672, 0.0016766167814567454, 0.0014401878230029322, 0.0013404581510862747, 0.0014912965194689536, 0.0016393642086953882, 0.0012433544335379784, 0.0011797094415905672, 0.0016738952982502456, 0.0016267278164537775, 0.0013901124104581837, 0.001355473465966886, 0.001538911038521159, 0.001692780844624736, 0.001476250137864149, 0.001365427854461889, 0.001380762410611771, 0.0014030683040726355, 0.0016569537875783108, 0.001605165181913816, 0.0016314709957831151, 0.0014219297403565527, 0.001449718200524034, 0.001917502429225372, 0.001629563086147888, 0.001668567467976237, 0.0018824022761638678, 0.001579693975024398, 0.0013629445136643936, 0.0015901065494006508, 0.001859226240935076, 0.00179569336062552, 0.001621287207230395, 0.0016729840651526738, 0.0018401794893747533, 0.0017963558494316946, 0.0015351985055947655, 0.0013390700253294863, 0.0013739993710491956, 0.0016494582199715231, 0.0018473200202330162},
.param_6 = {2.600400397271546, 1.485318962359372, 0.35268542086474286, 0.3132483860094182, 0.27102222919254404, 0.240345913972409, 0.2073258206830908, 0.18598815132363777, 0.1720010742505912, 0.15398752632508617, 0.1454145488016506, 0.1148975276266756, 0.0920898604445386, 0.06759247613236652, 0.049788286566326834, 0.04334509871659897, 0.0259160069358777, 0.024370319505148674, 0.02829992538568027, 0.021859492147080495, 0.012228615019982403, 0.022791519107900893, 0.022205349719628398, 0.011841772446721799, 0.02425440911009713, 0.0291682009403188, 0.015466868645044873, 0.016296421372621883, 0.029096181163351664, 0.03355144266534993, 0.0329436728062682, 0.03295050015737766, 0.033647077231122036, 0.03505221861727359, 0.028741381909042074, 0.029432795219752617, 0.03718567504893133, 0.02878944086923685, 0.028579776815793045, 0.02848276979250941, 0.027851873801795768, 0.02632192438909997, 0.025177785122326712, 0.028324899085041544, 0.029332948116628232, 0.022453240490499793, 0.016665890961087282, 0.03124375558825887, 0.02358588548552476, 0.015746219673984374, 0.01793315092083192, 0.02085454302859502, 0.02241557922664783, 0.019181567693060675, 0.022930772194654225, 0.02292930817793526, 0.01952549949360005, 0.017156231672824096, 0.020438892205254522, 0.022985002488859485, 0.02362336832167633, 0.021408208312387322, 0.015582658620166834, 0.018697432755035437, 0.023622791319530267, 0.016705627422769487, 0.01696029394054055, 0.018717998478195996, 0.01161034864931021, 0.014747287367500306, 0.018682137720965608, 0.01668735390883691, 0.016953243617939817, 0.009374471248332905, 0.012692353549678681, 0.011452900874675542, 0.004926890890624702, 0.01136023600389613, 0.011889712909934902, 0.010888995431437842, 0.014269545420800278, 0.01973774752203894, 0.013319065538752728, 0.0034292357747545132, 0.007002268231356967, 0.012087499929491763, 0.011333267736959862, 0.012212586642629253, 0.006300474969031522, 0.007942581972159024, 0.0177768102076703, 0.014077232089862446, 0.011212440602437201, 0.01070379468001148, 0.004262374717284301, 0.006396287036178339, 0.011889115554478136, 0.011872281572108956, 0.009981959287574949, 0.021240167484420924, 0.019556615738861027, 0.0018946872967467998, 0.015259282784854666, 0.022936941917731102, 0.007040329563323677, 0.006512042635636872, 0.018565415098520388, 0.017862638247270746, 0.01102879088270281, 0.015778698994886597, 0.01934782691671022, 0.012574789055760927, 0.013309973506034356, 0.019170223242812034, 0.016038303070425863, 0.018395379776425802, 0.023732507833659766, 0.016969888728765592, 0.01628372399083977, 0.02354865839592768, 0.018688200710539893, 0.018500978229685217, 0.028720607975443735, 0.026604317311437753, 0.0220679797753337, 0.02373798713567188, 0.029977636258526896, 0.03502563905288525, 0.03455392687118364, 0.03478413466932173, 0.03401134474416423, 0.03800557724135678, 0.04250732833577242, 0.03674418989595141, 0.03541797776381583, 0.042008772572110775, 0.03966436768152726, 0.040651089515228445, 0.04093495130126912, 0.034691381673335187, 0.034519863037216214, 0.03468003803278885, 0.034611548966032024, 0.03461830593528281, 0.03479123344158619, 0.03436602785769349, 0.03512491640690063, 0.04134103300597325, 0.034597283064558004, 0.027440747391133113, 0.03899087351384445, 0.04233747497122131, 0.035916083235404406, 0.03418757648586679, 0.03478553748200719, 0.03459335978742706, 0.034652162689538524, 0.0346693843833068, 0.03466650486821654, 0.034126870244055585, 0.03967101113496185, 0.04191541953641742, 0.03600469557507313, 0.03351145377716025, 0.03728241298672219, 0.04098410521738427, 0.03108386083844894, 0.02949273603976288, 0.041847382456255966, 0.0406681954113447, 0.03475281026145416, 0.0338868366491718, 0.03847277596303045, 0.042319521115619096, 0.03690625344660303, 0.03413569636154801, 0.034519060265295054, 0.035076707601813806, 0.041423844689456035, 0.04012912954784731, 0.04078677489458005, 0.03554824350891217, 0.036242955013099376, 0.04793756073063482, 0.04073907715369807, 0.04171418669940696, 0.04706005690409687, 0.039492349375608304, 0.03407361284160915, 0.0397526637350154, 0.04648065602337881, 0.0448923340156393, 0.04053218018075788, 0.04182460162881485, 0.04600448723436901, 0.04490889623579575, 0.03837996263987009, 0.033476750633235075, 0.03434998427623015, 0.04123645549928834, 0.0461830005058228},
.param_7 = {0.0001257783846500993, 0.0001319116411421046, 0.00013804489763411023, 0.0001441781541261155, 0.0001503114106181211, 0.00015644466711012644, 0.00016257792360213204, 0.00016871118009413738, 0.00017484443658614295, 0.00018097769307814826, 0.0001871109495701539, 0.00019324420606215917, 0.00019937746255416474, 0.00024062956070287567, 0.00028370710264830827, 0.000326784644593739, 0.00036986218653917163, 0.00041436205737235956, 0.00046195184310445035, 0.0005095416288365389, 0.0005571314145686295, 0.0006055744239719313, 0.0006603133495128293, 0.000715052275053725, 0.0007697912005946231, 0.000828718461755893, 0.0008923408446932386, 0.0009559632276305873, 0.0010214892488316035, 0.0010908291264619513, 0.0011601690040923, 0.0012372308452148245, 0.0013236089447629638, 0.0014098112193108824, 0.001494946837444399, 0.00158008245557792, 0.0016784854064756853, 0.0017802870445915166, 0.0018850975062478263, 0.001990504234394245, 0.002104284120011194, 0.0022306581639005806, 0.0024068981946979767, 0.002576738561988023, 0.0028969362146022528, 0.0033890287127995434, 0.0041628454790741416, 0.004908745534753491, 0.005648506291793405, 0.006128050296390866, 0.006602900849090915, 0.007121228109569626, 0.007640805747686387, 0.008171759187092106, 0.008804035981120291, 0.009460204024185462, 0.010262611954033827, 0.010988837165850798, 0.011786972357263647, 0.012596977115297468, 0.013390089032028346, 0.014415094359640621, 0.015914536913731944, 0.01728507640554087, 0.018679078629527782, 0.019951907504063893, 0.021289054396064964, 0.022383987246781242, 0.02322057944665835, 0.024054363828592933, 0.024713669166476125, 0.025314338275757606, 0.025774505583238596, 0.0262259095461646, 0.026617473795822834, 0.02703951395000206, 0.027437705856825357, 0.02785515512358306, 0.028316263693983396, 0.028776799530015627, 0.029236036896369843, 0.029659400124709114, 0.030113447289891536, 0.0305462016749411, 0.031005114745738242, 0.031465265223038615, 0.031930960943391484, 0.032311682310050084, 0.03277589887516115, 0.033181803331303085, 0.033652545905637356, 0.03407982716470964, 0.0345063110294453, 0.034929820694751645, 0.03538986088046211, 0.0357752464322575, 0.03617461160620282, 0.03658926682287066, 0.03698014497194607, 0.037319733907147816, 0.03777096650073565, 0.038113897043456225, 0.03850161833944006, 0.03885651623765986, 0.039243179593723615, 0.039708532458807136, 0.0399361022364217, 0.0399361022364217, 0.0399361022364217, 0.0399361022364217, 0.0399361022364217, 0.0399361022364217, 0.0399361022364217, 0.0399361022364217, 0.0399361022364217, 0.0399361022364217, 0.0399361022364217, 0.0399361022364217, 0.0399361022364217, 0.0399361022364217, 0.0399361022364217, 0.0399361022364217},
.param_8 = {5.031135386003973e-06, 5.276465645684185e-06, 5.52179590536441e-06, 5.767126165044621e-06, 6.012456424724846e-06, 6.257786684405059e-06, 6.503116944085283e-06, 6.748447203765496e-06, 6.99377746344572e-06, 7.239107723125932e-06, 7.484437982806157e-06, 7.729768242486369e-06, 7.975098502166592e-06, 9.625182428115029e-06, 1.1348284105932335e-05, 1.3071385783749563e-05, 1.4794487461566869e-05, 1.6574482294894384e-05, 1.8478073724178016e-05, 2.038166515346156e-05, 2.2285256582745184e-05, 2.4222976958877257e-05, 2.6412533980513178e-05, 2.8602091002149004e-05, 3.0791648023784925e-05, 3.314873847023573e-05, 3.569363378772955e-05, 3.82385291052235e-05, 4.0859569953264146e-05, 4.363316505847807e-05, 4.640676016369201e-05, 4.948923380859299e-05, 5.294435779051856e-05, 5.63924487724353e-05, 5.979787349777597e-05, 6.320329822311681e-05, 6.713941625902743e-05, 7.121148178366068e-05, 7.540390024991306e-05, 7.962016937576981e-05, 8.417136480044778e-05, 8.922632655602323e-05, 9.627592778791908e-05, 0.00010306954247952094, 0.00011587744858409014, 0.00013556114851198176, 0.0001665138191629657, 0.00019634982139013965, 0.00022594025167173623, 0.0002451220118556347, 0.00026411603396363665, 0.0002848491243827851, 0.00030563222990745556, 0.00032687036748368426, 0.00035216143924481167, 0.00037840816096741854, 0.00041050447816135314, 0.000439553486634032, 0.00047147889429054597, 0.0005038790846118988, 0.0005356035612811339, 0.0005766037743856249, 0.0006365814765492779, 0.000691403056221635, 0.0007471631451811115, 0.0007980763001625558, 0.0008515621758425988, 0.0008953594898712499, 0.0009288231778663342, 0.0009621745531437176, 0.0009885467666590451, 0.0010125735310303045, 0.001030980223329544, 0.0010490363818465842, 0.0010646989518329135, 0.0010815805580000827, 0.0010975082342730145, 0.0011142062049433227, 0.0011326505477593362, 0.0011510719812006253, 0.001169441475854794, 0.0011863760049883648, 0.0012045378915956615, 0.0012218480669976442, 0.0012402045898295298, 0.0012586106089215448, 0.0012772384377356598, 0.0012924672924020037, 0.0013110359550064462, 0.0013272721332521237, 0.0013461018362254944, 0.001363193086588386, 0.0013802524411778122, 0.001397192827790066, 0.0014155944352184846, 0.0014310098572903, 0.0014469844642481132, 0.0014635706729148267, 0.0014792057988778431, 0.0014927893562859129, 0.0015108386600294263, 0.0015245558817382494, 0.0015400647335776026, 0.0015542606495063946, 0.0015697271837489448, 0.0015883412983522856, 0.0015974440894568685, 0.0015974440894568685, 0.0015974440894568685, 0.0015974440894568685, 0.0015974440894568685, 0.0015974440894568685, 0.0015974440894568685, 0.0015974440894568685, 0.0015974440894568685, 0.0015974440894568685, 0.0015974440894568685, 0.0015974440894568685, 0.0015974440894568685, 0.0015974440894568685, 0.0015974440894568685, 0.0015974440894568685},
.param_9 = {0.4260018679815837},
.param_10 = {92.05170447503677, 0.047395063150387585},
.param_11 = {0.04877795234213739, 0.000291830073521456},
.param_12 = {2.4112349305864194},
.name = {'L', 'I', 'P', '3', '0', '0', '0'},
