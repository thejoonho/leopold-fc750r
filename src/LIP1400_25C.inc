/*
 * Copyright (c) 2023 Nordic Semiconductor ASA
 * SPDX-License-Identifier: LicenseRef-Nordic-5-Clause
 */

.param_1 = {0.0, 0.005, 0.01, 0.015, 0.02, 0.025, 0.03, 0.035, 0.04, 0.045, 0.05, 0.055, 0.06, 0.065, 0.07, 0.075, 0.08, 0.085, 0.09, 0.095, 0.1, 0.105, 0.11, 0.115, 0.12, 0.125, 0.13, 0.135, 0.14, 0.145, 0.15, 0.155, 0.16, 0.165, 0.17, 0.17500000000000002, 0.18, 0.185, 0.19, 0.195, 0.2, 0.20500000000000002, 0.21, 0.215, 0.22, 0.225, 0.23, 0.23500000000000001, 0.24, 0.245, 0.25, 0.255, 0.26, 0.265, 0.27, 0.275, 0.28, 0.28500000000000003, 0.29, 0.295, 0.3, 0.305, 0.31, 0.315, 0.32, 0.325, 0.33, 0.335, 0.34, 0.34500000000000003, 0.35000000000000003, 0.355, 0.36, 0.365, 0.37, 0.375, 0.38, 0.385, 0.39, 0.395, 0.4, 0.405, 0.41000000000000003, 0.41500000000000004, 0.42, 0.425, 0.43, 0.435, 0.44, 0.445, 0.45, 0.455, 0.46, 0.465, 0.47000000000000003, 0.47500000000000003, 0.48, 0.485, 0.49, 0.495, 0.5, 0.505, 0.51, 0.515, 0.52, 0.525, 0.53, 0.535, 0.54, 0.545, 0.55, 0.555, 0.56, 0.5650000000000001, 0.5700000000000001, 0.5750000000000001, 0.58, 0.585, 0.59, 0.595, 0.6, 0.605, 0.61, 0.615, 0.62, 0.625, 0.63, 0.635, 0.64, 0.645, 0.65, 0.655, 0.66, 0.665, 0.67, 0.675, 0.68, 0.685, 0.6900000000000001, 0.6950000000000001, 0.7000000000000001, 0.705, 0.71, 0.715, 0.72, 0.725, 0.73, 0.735, 0.74, 0.745, 0.75, 0.755, 0.76, 0.765, 0.77, 0.775, 0.78, 0.785, 0.79, 0.795, 0.8, 0.805, 0.81, 0.8150000000000001, 0.8200000000000001, 0.8250000000000001, 0.8300000000000001, 0.835, 0.84, 0.845, 0.85, 0.855, 0.86, 0.865, 0.87, 0.875, 0.88, 0.885, 0.89, 0.895, 0.9, 0.905, 0.91, 0.915, 0.92, 0.925, 0.93, 0.935, 0.9400000000000001, 0.9450000000000001, 0.9500000000000001, 0.9550000000000001, 0.96, 0.965, 0.97, 0.975, 0.98, 0.985, 0.99, 0.995, 1.0},
.temps = {26.0},
.param_2 = {2.99, 3.0, 3.0100000000000002, 3.02, 3.0300000000000002, 3.04, 3.0500000000000003, 3.06, 3.0700000000000003, 3.08, 3.0900000000000003, 3.1, 3.1100000000000003, 3.12, 3.1300000000000003, 3.14, 3.1500000000000004, 3.16, 3.1700000000000004, 3.18, 3.1900000000000004, 3.2, 3.2100000000000004, 3.22, 3.2300000000000004, 3.24, 3.25, 3.2600000000000002, 3.2700000000000005, 3.2800000000000002, 3.29, 3.3000000000000003, 3.31, 3.3200000000000003, 3.33, 3.3400000000000003, 3.35, 3.3600000000000003, 3.37, 3.3800000000000003, 3.39, 3.4000000000000004, 3.41, 3.4200000000000004, 3.43, 3.4400000000000004, 3.45, 3.4600000000000004, 3.47, 3.4800000000000004, 3.49, 3.5, 3.5100000000000002, 3.5200000000000005, 3.5300000000000002, 3.54, 3.5500000000000003, 3.5600000000000005, 3.5700000000000003, 3.58, 3.5900000000000003, 3.6, 3.6100000000000003, 3.62, 3.6300000000000003, 3.64, 3.6500000000000004, 3.66, 3.6700000000000004, 3.68, 3.6900000000000004, 3.7, 3.71, 3.72, 3.7300000000000004, 3.74, 3.75, 3.7600000000000002, 3.7700000000000005, 3.7800000000000002, 3.79, 3.8000000000000003, 3.8100000000000005, 3.8200000000000003, 3.83, 3.8400000000000003, 3.85, 3.8600000000000003, 3.87, 3.8800000000000003, 3.89, 3.9000000000000004, 3.91, 3.9200000000000004, 3.93, 3.9400000000000004, 3.95, 3.96, 3.97, 3.9800000000000004, 3.99, 4.0, 4.01, 4.0200000000000005, 4.03, 4.04, 4.050000000000001, 4.0600000000000005, 4.07, 4.08, 4.09, 4.1000000000000005, 4.11, 4.12, 4.130000000000001, 4.140000000000001, 4.15, 4.16, 4.17, 4.18, 4.19, 4.2},
.param_3 = {0.10663374045809486, 0.12299423981858863, 0.1292478067824808, 0.13103633272597512, 0.13277052090028224, 0.13434496663947632, 0.13552417781666692, 0.13655582887908183, 0.13756853796213203, 0.13846643154940952, 0.13923056209999174, 0.1399292805485017, 0.1405156669635396, 0.14085212221758062, 0.1411137119440978, 0.1412816024238464, 0.1413395536433149, 0.14135678682562436, 0.1413783316247036, 0.14144063405074386, 0.1415246990013051, 0.14158022726016983, 0.14158241537794836, 0.14160161774131613, 0.14162082010468394, 0.14165220922598862, 0.14169942943739247, 0.14171289225914874, 0.141731079054232, 0.14180500675833277, 0.14194426636027657, 0.14211445534937364, 0.142281630001922, 0.14242511407140135, 0.14252887911377093, 0.1425973624586087, 0.14266474534257897, 0.14276278073139947, 0.14288770488741523, 0.14301977184345158, 0.14314497688762595, 0.14326100283197185, 0.14336704937706105, 0.14346363953520241, 0.14355212289220562, 0.14363251656564424, 0.1437010471536959, 0.14375388233190756, 0.14379790334525513, 0.14384919061967885, 0.14391856574169917, 0.1439945183110892, 0.14406028491969475, 0.14411021300488833, 0.144151687951596, 0.1441926660252661, 0.1442401055035815, 0.14430050331782826, 0.1443734238312902, 0.14444728221687222, 0.14451039623668355, 0.14455875315341893, 0.14459220104635395, 0.14461433463646814, 0.14463703815830078, 0.14467241436541467, 0.14472102473162213, 0.14477545252901075, 0.1448286683435161, 0.14487535838148405, 0.14491079169638915, 0.14493537866705677, 0.1449543879310911, 0.1449732643404013, 0.14499738950275456, 0.14503201513560018, 0.14507810166191604, 0.14513107506592765, 0.1451857016161527, 0.14523485392620877, 0.14527073992519113, 0.14529320416948494, 0.14531561724990485, 0.14535134073397044, 0.14540049881342765, 0.14545590435497258, 0.14551020803116363, 0.14555585025830414, 0.14558608765133538, 0.1456066038841405, 0.14563251649357603, 0.14567444933713694, 0.14572653557933, 0.145779499378488, 0.14582856849887385, 0.14587363779049872, 0.14591605270750813, 0.14596331319482994, 0.1460246226772044, 0.1460991545191221, 0.1461718770591084, 0.14622907064695365, 0.14627423193708383, 0.14631836037141155, 0.14636715184437818, 0.14641589680080563, 0.1464596682938393, 0.14650409955837665, 0.1465612291580163, 0.1466354360168703, 0.14670995669348572, 0.1467658568892633, 0.1468079033437062, 0.14686061720822866, 0.14694236547622136, 0.1470452960240991, 0.14715523044916648, 0.1472589192304636, 0.14734416988732743, 0.14740246333132656, 0.14744538366974624, 0.14749137236682736, 0.14755351008898643, 0.14763651985668313, 0.14774314564215973, 0.14786597655975037, 0.1479927059088103, 0.1481149849392727, 0.14823305217238836, 0.14834852605917453, 0.14846626328392734, 0.14859328285790546, 0.1487334064152337, 0.1488806614662347, 0.1490274877332008, 0.14917138993736148, 0.14931450324031836, 0.14945856467659915, 0.14960285906385348, 0.14974606347936856, 0.14988875453693246, 0.15003387978980479, 0.15018309264788385, 0.15032909759278426, 0.15046129588562088, 0.15057884895307924, 0.15069765599583712, 0.15083306412793643, 0.15098039888807052, 0.1511242952957357, 0.15125359601482274, 0.15136741607568294, 0.15146685397373302, 0.15155980886794496, 0.15165918836733686, 0.151773677846606, 0.15189732827509353, 0.15202132409986607, 0.1521418753390634, 0.15226025202350965, 0.1523781240452192, 0.15249801606337418, 0.15262257151438818, 0.1527482685488446, 0.1528630977510864, 0.15295796433836065, 0.15304839760948818, 0.1531602579309587, 0.15330276375259724, 0.1534535080408098, 0.15358870438052846, 0.15370680019238298, 0.1538193773910285, 0.15393559899150766, 0.15405777598474554, 0.15418702967074083, 0.1543233599317358, 0.1544658584624245, 0.1546135908467684, 0.15476562266872915, 0.1549210091074869, 0.15507852127646077, 0.15523661888138213, 0.15539374574033546, 0.1555483456714049, 0.15569888546933316, 0.15584506989251856, 0.15598844577046794, 0.15613070974516122, 0.1562735584585785, 0.15641868545064758, 0.15656733554805277, 0.15671983956491098, 0.15687641710925931, 0.15703728778913478, 0.1572026712125744, 0.15737278698761514, 0.1575478547222941, 0.15772809402464824, 0.15791372450271463, 0.1581049657645303},
.param_4 = {0.004101297709926726, 0.004730547685330332, 0.0049710694916338775, 0.005039858950999044, 0.005106558496164702, 0.00516711410151832, 0.005212468377564112, 0.005252147264580071, 0.0052910976139281555, 0.0053256319826695975, 0.005355021619230452, 0.005381895405711604, 0.005404448729366908, 0.005417389316060793, 0.0054274504593883775, 0.005433907785532555, 0.005436136678589035, 0.005436799493293245, 0.005437628139411677, 0.005440024386567072, 0.00544325765389635, 0.005445393356160379, 0.005445477514536476, 0.005446216066973698, 0.005446954619410921, 0.005448161893307255, 0.005449978055284327, 0.005450495856121106, 0.005451195348239692, 0.005454038721474338, 0.005459394860010638, 0.005465940590360525, 0.005472370384689309, 0.005477889002746207, 0.005481879965914267, 0.00548451394071572, 0.005487105590099192, 0.005490876181976904, 0.005495680957208278, 0.005500760455517369, 0.00550557603413946, 0.005510038570460457, 0.0055141172837331175, 0.005517832289815478, 0.005521235495854062, 0.005524327560217087, 0.005526963352065227, 0.005528995474304137, 0.005530688590202121, 0.005532661177679957, 0.0055353294516038145, 0.005538250704272662, 0.00554078018921903, 0.005542700500188014, 0.005544295690446001, 0.005545871770202542, 0.005547696365522365, 0.005550019358378011, 0.005552823993511162, 0.005555664700648932, 0.005558092162949368, 0.005559952044362267, 0.005561238501782844, 0.005562089793710314, 0.0055629630060884915, 0.005564323629439026, 0.0055661932589085444, 0.005568286635731183, 0.005570333397827543, 0.005572129168518618, 0.00557349198832266, 0.005574437641040646, 0.005575168766580428, 0.005575894782323128, 0.005576822673182868, 0.005578154428292315, 0.005579926986996771, 0.005581964425612602, 0.005584065446775105, 0.005585955920238799, 0.005587336150968889, 0.005588200160364805, 0.005589062201919418, 0.005590436182075786, 0.0055923268774395254, 0.005594457859806638, 0.005596546462737063, 0.005598301933011698, 0.005599464909666747, 0.0056002539955438664, 0.005601250634368309, 0.005602863436043729, 0.005604866753051154, 0.005606903822249538, 0.005608791096110534, 0.005610524530403798, 0.005612155873365697, 0.005613973584416537, 0.005616331641430939, 0.005619198250735465, 0.005621995271504169, 0.005624195024882833, 0.0056259319975801485, 0.0056276292450542905, 0.005629505840168391, 0.005631380646184832, 0.005633064165147666, 0.005634773059937564, 0.0056369703522313975, 0.0056398244621873195, 0.005642690642057143, 0.00564484064958705, 0.0056464578209117775, 0.005648485277239564, 0.0056516294413931295, 0.005655588308619197, 0.005659816555737172, 0.005663804585787062, 0.005667083457204901, 0.00566932551274333, 0.005670976294990241, 0.005672745091031822, 0.005675135003422555, 0.005678327686795505, 0.005682428678544606, 0.005687152944605783, 0.005692027150338859, 0.0056967301899720265, 0.005701271237399552, 0.0057057125407374825, 0.005710240895535667, 0.005715126263765595, 0.0057205156313551424, 0.005726179287162874, 0.005731826451276955, 0.005737361151436981, 0.005742865509243014, 0.005748406333715353, 0.005753956117840519, 0.005759463979975714, 0.005764952097574326, 0.0057705338380694155, 0.005776272794149379, 0.005781888368953241, 0.005786972918677727, 0.0057914941905030486, 0.005796063692147582, 0.005801271697228325, 0.0058069384187719435, 0.005812472895989835, 0.005817446000570106, 0.005821823695218575, 0.005825648229758963, 0.005829223417997883, 0.005833045706436034, 0.005837449147946386, 0.005842204933657443, 0.005846974003841003, 0.005851610589963977, 0.005856163539365756, 0.005860697078662278, 0.0058653083101297765, 0.005870098904399546, 0.005874933405724793, 0.005879349913503324, 0.005882998628398487, 0.005886476831134162, 0.005890779151190719, 0.005896260144330663, 0.005902058001569608, 0.005907257860789557, 0.005911800007399345, 0.005916129899654942, 0.0059205999612118336, 0.005925299076336367, 0.005930270371951572, 0.0059355138435283, 0.005940994556247097, 0.005946676571029554, 0.0059525239487972755, 0.005958500350287959, 0.005964558510633107, 0.005970639187745467, 0.005976682528474441, 0.00598262867966942, 0.00598841867189743, 0.005994041149712253, 0.00599955560655646, 0.006005027297890817, 0.006010521479176096, 0.006016103286563369, 0.0060218205980020305, 0.0060276861371119615, 0.006033708350356128, 0.006039895684197492, 0.006046256585099015, 0.00605279949952366, 0.006059532873934389, 0.006066465154794164, 0.006073604788565948, 0.006080960221712704},
.param_5 = {0.12584999508072123, 0.08697717817071514, 0.030931126566871147, 0.013548900453082442, 0.012725515051927646, 0.010590988139941044, 0.008503316306175072, 0.007862923636404312, 0.007348471808952661, 0.006392400530229672, 0.005626342304200678, 0.004942711013645584, 0.003549391034918855, 0.0023001730021469415, 0.0016518469471761901, 0.0008686219200657562, 0.00028917077606899905, 0.0001491460822642364, 0.0003224893273826891, 0.0005629514484672797, 0.0005368969593307071, 0.00022198606401254914, 8.227108133189442e-05, 0.00014771048744456616, 0.00019458263335577278, 0.00030234358734055125, 0.00023339628138505444, 0.00012172929553652331, 0.0003542865353232255, 0.0008199511770945467, 0.0011901868886186884, 0.0012975524678671309, 0.00119484123856815, 0.0009509581224958347, 0.0006624937969513037, 0.0005225624184924428, 0.0006362241261183982, 0.0008575367109086435, 0.0009884273540465387, 0.0009895076931182127, 0.0009278114943087751, 0.0008541249593657305, 0.0007793719355021593, 0.0007118212120944475, 0.0006495270401608681, 0.0005727856211164978, 0.0004667914087049842, 0.0003725238136894314, 0.000366570337582018, 0.00046408614016932304, 0.0005589526592704626, 0.0005450737615215161, 0.0004449795915351974, 0.0003515501226971328, 0.00031712700145286946, 0.0003400675076364358, 0.00041475881754687513, 0.0005127627988796984, 0.000564534227092111, 0.0005268169438205766, 0.00042873437133350914, 0.0003146338833475912, 0.00021377493480464332, 0.00017245043056474119, 0.00022338357287127186, 0.0003230252820052987, 0.00039630062921569564, 0.00041401389189984, 0.0003842532787434391, 0.0003158590495116846, 0.00023084725220279267, 0.00016767782577680607, 0.00014571412824820884, 0.0001653906602440587, 0.00022596459691871101, 0.00031043138139022486, 0.00038099973202867024, 0.00041384597783342136, 0.0003991494626197703, 0.0003270704193784543, 0.0002244240126006089, 0.00017260509505290234, 0.0002236021710980314, 0.0003264675520107084, 0.0004021677730852227, 0.00042195852975376175, 0.00038440732050603124, 0.00029184469296835575, 0.0001952062532168189, 0.00017857247015624564, 0.00026094404998629195, 0.0003616118682844491, 0.0004040386205808946, 0.00039243430593801504, 0.00036207081542593764, 0.0003364777255163501, 0.000344905401273958, 0.0004175768065241975, 0.0005224666318927838, 0.0005663630073230071, 0.0004996774147367905, 0.0003936726075979245, 0.00034342201714575304, 0.0003573842588242872, 0.00037514011305417316, 0.00035583249792742536, 0.000339241375273136, 0.0003906187083731888, 0.0005051402249755914, 0.0005720289825745725, 0.000501618739973033, 0.00037671788546342344, 0.000364462765251386, 0.0005171620481352057, 0.000710303137963289, 0.0008187114344042692, 0.0008216277167865174, 0.0007266901467729153, 0.0005520926956267998, 0.0003892837785339498, 0.00034195782884919104, 0.00041587084323143134, 0.0005582595763683681, 0.0007293675122050508, 0.0008825257810277966, 0.000959847179425339, 0.0009577245366243145, 0.0009244087060693122, 0.0008982350765456004, 0.0008969658136115215, 0.0009413723028112858, 0.0010274735819475016, 0.001105302339727849, 0.0011310819921812355, 0.0011181864274107008, 0.001103905796605905, 0.001104518227837241, 0.0011090608597504915, 0.0011057646260360411, 0.0010995979733806859, 0.0011069858093701833, 0.0011320696575053274, 0.0011354530883825494, 0.0010700124528348343, 0.0009605821549807554, 0.0009090773469854797, 0.0009777506725276199, 0.0010874726624361501, 0.0011201198761510468, 0.0010507581798162476, 0.0009350799228739597, 0.0008202229188856817, 0.0007399722779308573, 0.0007397476677071212, 0.000822572994850241, 0.0009159227221409126, 0.0009524855894616803, 0.0009405656306533949, 0.0009189535524753607, 0.000908648869830074, 0.0009144770764020309, 0.000940182573726852, 0.0009625095595016363, 0.0009251009103777678, 0.0008065222673694396, 0.0007126917630838163, 0.0007780522792232014, 0.000978331319650104, 0.0011278850378888816, 0.0010997716458893518, 0.0009742005829736951, 0.0008872038865384915, 0.0008799953812488499, 0.000916917668142541, 0.0009670410739738046, 0.0010214767191932955, 0.0010724184295525171, 0.0011162727501254008, 0.00115293925501787, 0.0011823779258404547, 0.0012034561835831507, 0.0012138837457508801, 0.0012124017841333955, 0.0011989491923952537, 0.0011736143422988801, 0.0011412470042833356, 0.0011136934659029991, 0.0010986148178563325, 0.0010965872619636205, 0.001107598867255196, 0.001129911882593454, 0.0011582850548592927, 0.001188775235409778, 0.0012209547085530528, 0.0012548234742886834, 0.0012903815326167564, 0.0013276288835373587, 0.0013665655270504035, 0.0014071914631558907, 0.001449506691853994, 0.0014710866293511995},
.param_6 = {3.272099872098755, 2.2614066324385935, 0.8042092907386486, 0.35227141178014454, 0.33086339135011966, 0.27536569163846836, 0.221086223960551, 0.20443601454651072, 0.19106026703276935, 0.16620241378597078, 0.14628489990921867, 0.12851048635478535, 0.0922841669078911, 0.059804498055821, 0.04294802062657921, 0.02258416992171053, 0.007518440177795016, 0.003877798138868238, 0.008384722511950438, 0.014636737660150834, 0.013959320942596998, 0.005771637664325757, 0.002139048114629949, 0.0038404726735580264, 0.005059148467248531, 0.007860933270853465, 0.006068303316011936, 0.0031649616839518613, 0.00921144991840317, 0.021318730604458214, 0.030944859104087286, 0.03373636416454384, 0.031065872202770684, 0.024724911184892395, 0.017224838720736324, 0.013586622880804033, 0.01654182727907627, 0.022295954483625424, 0.02569911120521018, 0.025727200021072316, 0.024123098852027458, 0.02220724894350934, 0.020263670323056315, 0.01850735151445737, 0.016887703044182745, 0.01489242614902686, 0.012136576626331497, 0.009685619155924696, 0.009530828777129519, 0.012066239644403787, 0.01453276914103463, 0.01417191779955751, 0.011569469379912878, 0.009140303190124932, 0.008245302037776514, 0.00884175519854924, 0.010783729256216845, 0.013331832770871466, 0.014677889904396446, 0.013697240539334299, 0.01114709365467037, 0.008180480967040493, 0.005558148304921073, 0.004483711194683271, 0.005807972894653068, 0.008398657332134296, 0.010303816359608087, 0.010764361189397054, 0.009990585247329764, 0.008212335287305361, 0.0060020285572726095, 0.004359623470195917, 0.00378856733445343, 0.004300157166345353, 0.005875079519887527, 0.008071215916147234, 0.00990599303274664, 0.010759995423667568, 0.010377886028112293, 0.008503830903841547, 0.005835024327616178, 0.004487732471372685, 0.005813656448550031, 0.008488156352279286, 0.010456362100214056, 0.010970921773598152, 0.009994590333156639, 0.007587962017174821, 0.005075362583636944, 0.004642884224065336, 0.006784545299642897, 0.009401908575396023, 0.010505004135105689, 0.010203291954385962, 0.00941384120107247, 0.00874842086342753, 0.008967540433121868, 0.010856996969627053, 0.013584132429214635, 0.014725438190399398, 0.01299161278315586, 0.01023548779754413, 0.008928972445790273, 0.009291990729434763, 0.009753642939408502, 0.009251644946112192, 0.008820275757101537, 0.010156086417700827, 0.013133645849364162, 0.01487275354694062, 0.013042087239301114, 0.009794665022047622, 0.009476031896535342, 0.013446213251516737, 0.01846788158704482, 0.02128649729451204, 0.021362320636450494, 0.018893943816095105, 0.014354410086295233, 0.010121378241881307, 0.008890903550079488, 0.010812641924018429, 0.014514748985577919, 0.018963555317330627, 0.02294567030672323, 0.02495602666505725, 0.024900837952232524, 0.024034626357805067, 0.023354111990184223, 0.023321111153898344, 0.024475679873092737, 0.026714313130635214, 0.028737860832922513, 0.02940813179670987, 0.029072847112679434, 0.028701550711757173, 0.028717473923767223, 0.028835582353511913, 0.028749880276940365, 0.02858954730789731, 0.028781631043622857, 0.029433811095139206, 0.029521780297947497, 0.027820323773702915, 0.02497513602949808, 0.02363601102162438, 0.025421517485718637, 0.028274289223340077, 0.029123116779927738, 0.027319712675222263, 0.024312077994723125, 0.0213257958910279, 0.019239279226201944, 0.019233439360383242, 0.021386897866104704, 0.02381399077566737, 0.024764625326006984, 0.02445470639698688, 0.023892792364357818, 0.023624870615579496, 0.023776403986452976, 0.02444474691689902, 0.025025248547042023, 0.02405262366982075, 0.02096957895160456, 0.018529985840179397, 0.020229359259804625, 0.025436614310905825, 0.029325010985109534, 0.028594062793121933, 0.025329215157318674, 0.02306730105000321, 0.022879879912468537, 0.023839859371704852, 0.025143067923316664, 0.02655839469902499, 0.02788287916836718, 0.029023091503260767, 0.029976420630464795, 0.03074182607185061, 0.03128986077316209, 0.031560977389522016, 0.03152244638746915, 0.03117267900227816, 0.030513972899770536, 0.029672422111365337, 0.028956030113477804, 0.028563985264265512, 0.02851126881105448, 0.028797570548635965, 0.029377708947428416, 0.03011541142634022, 0.03090815612065423, 0.031744822422380414, 0.032625410331507676, 0.033549919848036014, 0.03451835097197098, 0.035530703703309796, 0.036586978042052465, 0.037687173988204536, 0.03824825236313223},
.param_7 = {9.620128534213109e-05, 0.00010070885874541455, 0.00010521643214869818, 0.00010972400555198159, 0.00011423157895526521, 0.00011873915235854865, 0.00012324672576183223, 0.0001277542991651157, 0.00013226187256839932, 0.00013676944597168272, 0.00014127701937496635, 0.00014578459277824976, 0.0001502921661815334, 0.00015479973958481687, 0.00015930731298810041, 0.00016381488639138388, 0.00016832245979466747, 0.00017283003319795094, 0.0001773376066012346, 0.00018184518000451794, 0.0001863527534078016, 0.000190860326811085, 0.00020077285965504392, 0.00021256551370474135, 0.0002243581677544393, 0.0002361508218041367, 0.00024794347585383413, 0.00025973612990353204, 0.00027152878395323, 0.0002833214380029274, 0.0002951140920526249, 0.0003069067461023228, 0.0003186994001520202, 0.00033049205420171814, 0.0003422847082514156, 0.00035407736230111343, 0.00036587001635081097, 0.0003776626704005088, 0.000402956496660874, 0.0004441894192528267, 0.00048542234184477764, 0.0005266552644367303, 0.0005678881870286814, 0.0006101566804037687, 0.0006526815648853857, 0.0006952064493670046, 0.0007377313338486214, 0.000781490136342082, 0.0008283295731965701, 0.0008751690100510604, 0.0009220084469055488, 0.0009717738102585702, 0.0010343123556932356, 0.0010968509011279003, 0.0011604260986753183, 0.0012319097179614438, 0.0013033933372475729, 0.0013754513929663942, 0.0014482720608325122, 0.00152109272869863, 0.0016012947247452, 0.001683427120862874, 0.0017720971737088368, 0.001868607058996909, 0.0019693185434919982, 0.002074863419169838, 0.0021934632355149583, 0.0023303274628890076, 0.0025647402939668147, 0.0030387150454624662, 0.005190438849008477, 0.005933589483774933, 0.006441192532493714, 0.007262894747691704, 0.007854148073546069, 0.008644317845434088, 0.009860964359158262, 0.011211074223774065, 0.012902992631882913, 0.014922181685664023, 0.016697911383097917, 0.018523286625262366, 0.019792793264339345, 0.021112548797760086, 0.022160983390073826, 0.02316295127077583, 0.023990793750601192, 0.024594312363184025, 0.025200331981844935, 0.025708740264257054, 0.026221693544050375, 0.026734847423017034, 0.02724083132070924, 0.027790631727140053, 0.028354562948976952, 0.028906503074308542, 0.02963785984444593, 0.030245503388412906, 0.030865752350660622, 0.03147133170416232, 0.0321684711242981, 0.03269312705085205, 0.033325949749660244, 0.033881919575065846, 0.034378935870527406, 0.03484928453752353, 0.03532091859944893, 0.035821023030564954, 0.03633702933819204, 0.0368325836249293, 0.037296757767769854, 0.037731611616559954, 0.038139984416616826, 0.03840472673559823, 0.03840472673559823, 0.03840472673559823, 0.03840472673559823, 0.03840472673559823, 0.03840472673559823, 0.03840472673559823, 0.03840472673559823, 0.03840472673559823},
.param_8 = {3.7000494362358118e-06, 3.873417644054406e-06, 4.046785851873007e-06, 4.2201540596916e-06, 4.393522267510201e-06, 4.566890475328794e-06, 4.740258683147394e-06, 4.913626890965988e-06, 5.086995098784589e-06, 5.2603633066031825e-06, 5.4337315144217825e-06, 5.607099722240376e-06, 5.7804679300589775e-06, 5.9538361378775725e-06, 6.127204345696171e-06, 6.300572553514765e-06, 6.473940761333366e-06, 6.64730896915196e-06, 6.820677176970562e-06, 6.994045384789152e-06, 7.167413592607754e-06, 7.340781800426347e-06, 7.722033063655536e-06, 8.175596680951591e-06, 8.629160298247666e-06, 9.08272391554372e-06, 9.536287532839774e-06, 9.98985115013585e-06, 1.0443414767431924e-05, 1.0896978384727978e-05, 1.1350542002024033e-05, 1.180410561932011e-05, 1.2257669236616163e-05, 1.2711232853912238e-05, 1.3164796471208293e-05, 1.3618360088504364e-05, 1.4071923705800423e-05, 1.4525487323096494e-05, 1.5498326794649e-05, 1.7084208432801025e-05, 1.8670090070952987e-05, 2.0255971709105014e-05, 2.1841853347256976e-05, 2.3467564630914182e-05, 2.5103137110976374e-05, 2.6738709591038642e-05, 2.8374282071100828e-05, 3.0057312936233923e-05, 3.1858829738329624e-05, 3.3660346540425404e-05, 3.546186334252111e-05, 3.737591577917578e-05, 3.978124444973983e-05, 4.2186573120303866e-05, 4.4631773025973786e-05, 4.738114299851707e-05, 5.01305129710605e-05, 5.290197665255363e-05, 5.570277157048124e-05, 5.8503566488408854e-05, 6.158825864404616e-05, 6.474719695626439e-05, 6.815758360418605e-05, 7.18695022691119e-05, 7.57430209035384e-05, 7.980243919883993e-05, 8.436397059672919e-05, 8.962797934188492e-05, 9.864385746026212e-05, 0.00011687365559471025, 0.00019963226342340298, 0.00022821498014518975, 0.00024773817432668135, 0.0002793421056804502, 0.00030208261821331036, 0.00033247376328592645, 0.00037926785996762546, 0.00043119516245284864, 0.0004962689473801121, 0.0005739300648332317, 0.0006422273608883815, 0.0007124341009716296, 0.0007612612793976672, 0.0008120211076061572, 0.0008523455150028395, 0.0008908827411836859, 0.0009227228365615844, 0.0009459350908916933, 0.0009692435377632667, 0.0009887977024714252, 0.0010085266747711685, 0.001028263362423732, 0.0010477242815657402, 0.0010688704510438483, 0.0010905601134221907, 0.0011117885797810978, 0.0011399176863248434, 0.001163288591862035, 0.0011871443211792549, 0.001210435834775474, 0.001237248889396081, 0.0012574279634943097, 0.0012817672980638556, 0.0013031507528871481, 0.0013222667642510543, 0.001340357097597059, 0.0013584968692095744, 0.001377731655021729, 0.0013975780514689248, 0.00141663783172805, 0.0014344906833757638, 0.0014512158314061523, 0.0014669224775621858, 0.001477104874446086, 0.001477104874446086, 0.001477104874446086, 0.001477104874446086, 0.001477104874446086, 0.001477104874446086, 0.001477104874446086, 0.001477104874446086, 0.001477104874446086},
.param_9 = {0.8638085085309641},
.param_10 = {126.33704692294887, 0.07720786537825243},
.param_11 = {0.13411223688693724, 0.0003712326694766536},
.param_12 = {1.0427044236109013},
.name = {'L', 'I', 'P', '1', '4', '0', '0', '0'},
